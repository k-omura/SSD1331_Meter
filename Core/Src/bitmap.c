/*
 * bitmap.c
 *
 *  Created on: 2020/05/04
 *      Author: k-omura
 */

#include "bitmap.h"
#include "math.h"

void drawLinerMode(int16_t _value, int16_t _scaleInterval, int16_t _resolution, uint8_t _center_y, uint8_t *_bitmap) {
	char measure[7];

	//scale
	for (uint8_t y = 0; y < OLED_HEIGHT2; y++) {
		int16_t virtualPixelY = _value - _resolution * (y - _center_y);
		virtualPixelY = virtualPixelY - (_resolution / 2);

		if (((virtualPixelY / _resolution) % (_scaleInterval / _resolution)) == 0) {
			addLine(25, y, 29, y, 32, _bitmap); //Scale line
			if ((y < (OLED_HEIGHT2 - 2)) && (y > 1)) {
				sprintf(measure, "%6d", virtualPixelY - (virtualPixelY % _scaleInterval));
				stringBitmap(0, y - 2, measure, 0, _bitmap, 32);
			}
		}
	}

	//Surface of revolution
	addLine(29, 0, 29, _center_y - 1, 32, _bitmap);
	addLine(31, 0, 31, _center_y - 1, 32, _bitmap);
	addLine(29, _center_y + 1, 29, OLED_HEIGHT2 - 1, 32, _bitmap);
	addLine(31, _center_y + 1, 31, OLED_HEIGHT2 - 1, 32, _bitmap);
}

void drawCircleMode(int16_t _value, int16_t _scaleInterval, int16_t _resolution, uint8_t _center_y, uint8_t *_bitmap) {
	uint8_t x1, x2, y1, y2;
	int8_t arc_resolution = 10;
	char measure[7];

	//scale
	for (int8_t deg = -90; deg < 90; deg++) {
		//Scale line
		int16_t virtualPixelY = _value - _resolution * deg;
		virtualPixelY = virtualPixelY - (_resolution / 2);

		if (((virtualPixelY / _resolution) % (_scaleInterval / _resolution)) == 0) {
			double cosdeg = cos((((double)deg) / 360) * 2 * M_PI);
			double sindeg = sin((((double)deg) / 360) * 2 * M_PI);

			x1 = 0 + 30 * cosdeg;
			y1 = _center_y + 30 * sindeg;
			x2 = 0 + 29 * cosdeg;
			y2 = _center_y + 29 * sindeg;

			addLine(x1, y1, x2, y2, 32, _bitmap);

			/*
			if ((y < (OLED_HEIGHT2 - 2)) && (y > 1)) {
				sprintf(measure, "%6d", virtualPixelY - (virtualPixelY % _scaleInterval));
				stringBitmap(0, y - 2, measure, 0, _bitmap, 32);
			}*/
		}

		//arc
		if((deg % arc_resolution) == 0){
			x1 = 0 + 31 * cos((((double)deg) / 360) * 2 * M_PI);
			y1 = _center_y + 31 * sin((((double)deg) / 360) * 2 * M_PI);
			x2 = 0 + 31 * cos((((double)deg + arc_resolution) / 360) * 2 * M_PI);
			y2 = _center_y + 31 * sin((((double)deg + arc_resolution) / 360) * 2 * M_PI);

			addLine(x1, y1, x2, y2, 32, _bitmap);
		}
	}

	sprintf(measure, "%5d", _scaleInterval);
	stringBitmap(0, 30, measure, 0, _bitmap, 32);
}

void addPixel(int _x, int _y, int _width, uint8_t *_bitmap) {
	if(_y < 0) return;
	_bitmap[(_x / 8) + (((_width + 7) / 8) * _y)] |= (1 << (7 - _x % 8));
}

/* Bresenham's line algorithm */
void addLine(int _x0, int _y0, int _x1, int _y1, int _width, uint8_t *_bitmap) {
	int dx = (_x1 > _x0) ? (_x1 - _x0) : (_x0 - _x1);
	int dy = (_y1 > _y0) ? (_y1 - _y0) : (_y0 - _y1);
	int sx, sy, err, e2;

	if (_x0 < _x1) {
		sx = 1;
	} else {
		sx = -1;
	}
	if (_y0 < _y1) {
		sy = 1;
	} else {
		sy = -1;
	}
	err = dx - dy;

	while (1) {
		addPixel(_x0, _y0, _width, _bitmap);
		if ((_x0 == _x1) && (_y0 == _y1)) {
			break;
		}
		e2 = 2 * err;
		if (e2 > -dy) {
			err -= dy;
			_x0 += sx;
		}
		if (e2 < dx) {
			err += dx;
			_y0 += sy;
		}
	}
}

void stringBitmap(uint8_t _x, uint8_t _y, const char _character[], uint8_t size,
		uint8_t *_bitmap, uint8_t _width) {
	uint8_t c = 0;
	while (_character[c]) {
		if (size == 0) {
			characterBitmap5(_x + (c * 4), _y, _character[c], _bitmap, _width);
		} else {
			characterBitmap8(_x + (c * 8), _y, _character[c], _bitmap, _width);
		}
		c++;
	}
}

void characterBitmap8(uint8_t _x, uint8_t _y, char _character, uint8_t *_bitmap, uint8_t _width) {
	uint8_t index = 0;

	for (uint8_t y = 0; y < 8; y++) {
		uint16_t fontByte;
		fontByte = FONT8x8[_character - 0x1F][y];

		for (uint8_t x = 0; x < 8; x++) {
			if(fontByte & 0x80){
				addPixel(_x + (index % 8), _y + (index / 8), _width, _bitmap);
			}
			fontByte = fontByte << 1;
			index++;
		}
	}
}

void characterBitmap5(uint8_t _x, uint8_t _y, char _character, uint8_t *_bitmap, uint8_t _width) {
	uint8_t code = 12;
	if ((0x30 <= _character) && (_character <= 0x39)) {
		code = _character - 0x30;
	} else if (_character == 0x2d) {
		code = 10;
	} else if (_character == 0x2e) {
		code = 11;
	}

	uint8_t index = 0;

	for (uint8_t array = 0; array < 2; array++) {
		uint16_t fontByte;
		fontByte = FONT5x3[code][array];

		for (uint8_t i = 0; i < 8; i++) {
			if(fontByte & 0x80){
				addPixel(_x + (index % 3), _y + (index / 3), _width, _bitmap);
			}
			fontByte = fontByte << 1;
			index++;
		}
	}
}

//--------
const unsigned char FONT8x8[][8] = { { 0x08, 0x08, 0x08, 0x00, 0x00, 0x00, 0x00,
		0x00 }, // columns, rows, num_bytes_per_char
		{ 0x00, 0x00, 0x00, 0x00, 0x00, 0x00, 0x00, 0x00 }, // space 0x20
		{ 0x30, 0x78, 0x78, 0x30, 0x30, 0x00, 0x30, 0x00 }, // !
		{ 0x6C, 0x6C, 0x6C, 0x00, 0x00, 0x00, 0x00, 0x00 }, // "
		{ 0x6C, 0x6C, 0xFE, 0x6C, 0xFE, 0x6C, 0x6C, 0x00 }, // #
		//{0x18, 0x3E, 0x60, 0x3C, 0x06, 0x7C, 0x18, 0x00}, // $
		{ 0xcc, 0xde, 0x33, 0x30, 0x30, 0x33, 0x1e, 0x0c }, //℃ instead of $
		{ 0x00, 0x63, 0x66, 0x0C, 0x18, 0x33, 0x63, 0x00 }, // %
		{ 0x1C, 0x36, 0x1C, 0x3B, 0x6E, 0x66, 0x3B, 0x00 }, // &
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		{ 0x1C, 0x36, 0x36, 0x1C, 0x00, 0x00, 0x00, 0x00 } // DEL
};

const unsigned char FONT5x3[][2] = { { 0b11110110, 0b11011110 }, // 0
		{ 0b11001001, 0b00101110 }, // 1
		{ 0b11100111, 0b11001110 }, // 2
		{ 0b11100111, 0b10011110 }, // 3
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		{ 0b00000000, 0b00000000 }, // space
		};
